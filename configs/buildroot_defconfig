## configs/buildroot_defconfig
```kconfig
BR2_x86_64=y

# Toolchain
BR2_TOOLCHAIN_BUILDROOT_GLIBC=y
BR2_TOOLCHAIN_BUILDROOT_CXX=y

# Init system
BR2_INIT_BUSYBOX=y

# Rootfs overlay (kiosk scriptleri buradan gelir)
BR2_ROOTFS_OVERLAY="../overlay"

# System identity
BR2_TARGET_GENERIC_HOSTNAME="kiosk"
BR2_TARGET_GENERIC_ISSUE="Kiosk Clock OS"

# Graphics stack (Wayland)
BR2_PACKAGE_WESTON=y
BR2_PACKAGE_MESA3D=y
BR2_PACKAGE_LIBDRM=y
BR2_PACKAGE_SEATD=y

# Fonts (Fyne için önemli)
BR2_PACKAGE_DEJAVU=y

# Rootfs output
BR2_TARGET_ROOTFS_EXT2=y
BR2_TARGET_ROOTFS_EXT2_4=y
BR2_TARGET_ROOTFS_EXT2_SIZE="512M"
```
